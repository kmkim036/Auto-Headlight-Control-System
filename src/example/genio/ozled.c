/* The screen is divided  into “8 pages” (I know it’s not divided into rows, but pages), and 128 columns.
For example, display a dot on the top left corner, we need to send a hex number 0x01 (B0000 0001) to the data register

  stmOzOLED - 0.96' I2C 128x64 OLED Driver Library
  Driver = SSD1306
  I2C 8Bit Address = 0x78 (128X32). 0x7A (128X64)
  2014 Copyright (c) OscarLiang.net  All right reserved.

  Author: Oscar Liang
  */

//x : column : Seg0..127
//y : row    : com0..63(31) : each 8 coms makes a page (page0..7(3))
//      seg | 0 | 1 | ... |127|
//page2 com |16 | <- LSB(D0)
//          |17 |
//           ...
//          |23 | <- MSB(D7)

// On reset, page addressing mode

#include "yInc.h"
#include <stdio.h>
#include <stdint.h>
#include <time.h>
#if (PROCESSOR == PROCESSOR_STM32F407VGT6)
#include "stm32f4xx.h"
#include "stm32f4xx_syscfg.h"
#include "core_cm4.h"
#include "stm32f4xx_usart.h"
#include "stm32f4xx_tim.h"
#include "stm32f4xx_rcc.h"
#include "stm32f4xx_gpio.h"
#include "stm32f4xx_exti.h"
#include "stm32f4xx_spi.h"
#elif ((PROCESSOR == PROCESSOR_STM32F103C8T6) || (PROCESSOR == PROCESSOR_STM32F103RCT6) || (PROCESSOR == PROCESSOR_STM32F107VCT))
#include "stm32f10x.h"
#include "stm32f10x_gpio.h"
#include "stm32f10x_usart.h"
#include "stm32f10x_i2c.h"
#include "stm32f10x_rcc.h"
#include "stm32f10x_exti.h"
#include "stm32f10x_spi.h"
#endif
#include "misc.h"

extern int stm_I2C_SendBurst(unsigned char slave_addr, unsigned char *burst, unsigned char datalen);
extern unsigned char stm_I2C_ReceiveBurstWithRestartCondition(unsigned char SlaveAddress, unsigned char reg, unsigned char *buf, unsigned char nbyte);
extern void stm_I2C_Init(I2C_TypeDef * I2Cx, u32 I2Cspeed);
extern I2C_TypeDef *gI2Cx;
extern unsigned char g_bI2CModuleConfigDone;
bool g_OzLED_InitDone;

#define I2C_400KHZ							1	// 0 to use default 100Khz, 1 for 400Khz

//128x32
#define OLED_SCREEN_WIDTH_IN_PIXEL			128	//128 Pixels  -- WIDTH
#define OLED_SCREEN_HEIGHT_IN_PIXEL 		32//....64 original -- HEIGHT

#if (OLED_SCREEN_HEIGHT_IN_PIXEL == 64)
	#define OLED_ADDRESS					0x7A //0x3D = 7bit address for 128X64 --> 0x7A (8 bit addr)
	#define OLED_CONTRAST                   0x9F //or 0xAF
#elif(OLED_SCREEN_HEIGHT_IN_PIXEL == 32)
	#define OLED_ADDRESS					0x78 //0x3C = 7bit address for 128X32 --> 0x78 (8 bit addr) for 128 x 32 OLED
	#define OLED_CONTRAST                   0x8F
#endif

// registers
#define SSD1306_OLED_COMMAND_MODE				0x80
#define SSD1306_OLED_DATA_MODE					0x40

// commands
#define SSD1306_OLED_MEMORY_MODE				0x20
#define SSD1306_OLED_COLADDR					0x21
#define SSD1306_OLED_PAGEADDR					0x22
#define SSD1306_OLED_RIGHT_SCROLL				0x26
#define SSD1306_OLED_LEFT_SCROLL				0x27
#define SSD1306_OLED_VERTICAL_RIGHT_SCROLL		0x29
#define SSD1306_OLED_VERTICAL_LEFT_SCROLL		0x2A
#define SSD1306_OLED_CMD_DEACTIVATE_SCROLL		0x2E
#define SSD1306_OLED_CMD_ACTIVATE_SCROLL		0x2F

#define SSD1306_OLED_CMD_SET_BRIGHTNESS			0x81 //SET_CONTRAST
#define SSD1306_OLED_CMD_CHARGEPUMP				0x8D

#define SSD1306_OLED_CMD_SEGREMAP				0xA0 //REMAP
#define SSD1306_OLED_SET_VERTICAL_SCROLL_AREA 	0xA3
#define SSD1306_OLED_CMD_DISPLAYALLON			0xA5
#define SSD1306_OLED_CMD_NORMAL_DISPLAY			0xA6
#define SSD1306_OLED_CMD_INVERSE_DISPLAY		0xA7
#define SSD1306_OLED_CMD_SETMULTIPLEX			0xA8
#define SSD1306_OLED_CMD_DISPLAY_OFF			0xAE
#define SSD1306_OLED_CMD_DISPLAY_ON				0xAF

#define SSD1306_OLED_SETDISPLAYOFFSET 			0xD3
#define SSD1306_OLED_SETDISPLAYCLOCKDIV 		0xD5
#define SSD1306_OLED_SETPRECHARGE 				0xD9
#define SSD1306_OLED_SETCOMPINS 				0xDA
#define SSD1306_OLED_SETVCOMDETECT				0xDB

#define SSD1306_SETSTARTLINE 					0x40

#define HORIZONTAL_ADDRESSING					0x00
#define PAGE_ADDRESSING							0x02

#define Scroll_Left				0x00
#define Scroll_Right			0x01
#define Scroll_Up				0x02
#define Scroll_Down				0x03

#define Scroll_2Frames			0x07
#define Scroll_3Frames			0x04
#define Scroll_4Frames			0x05
#define Scroll_5Frames			0x00
#define Scroll_25Frames			0x06
#define Scroll_64Frames			0x01
#define Scroll_128Frames		0x02
#define Scroll_256Frames		0x03


struct stmOzOLED {
	unsigned char addressingMode;
} g_OzOled;  // stmOzOLED object

//=============== FONT =======================================

#if 1

const unsigned char bitmaparray[][8] = {
		{~0x00,~0x7F,~0x40,~0x40,~0x40,~0x40,~0x00,~0x00}, //'L' INV
		{~0x00,~0x7F,~0x02,~0x0C,~0x02,~0x7F,~0x00,~0x00}, //'M'
		{0x7E,0xD9,0xB6,0xB6,0xB6,0xCD,0xFF,0x7E}          //'S' INV
};

// 8x8 Font ASCII 32 - 127 Implemented
#define OLED_CHAR_WIDTH_PIXEL_8X8  8 // character width in pixels
#define OLED_CHAR_HEIGHT_PAGE_8X8  1 // character height in pages (8 pixels)
#define BYTES_PER_FONT_8X8 		   8

const unsigned char Font8X8[][BYTES_PER_FONT_8X8] = {
	{0x00,0x00,0x00,0x00,0x00,0x00,0x00,0x00}, //#0 'NULL'
	{0x00,0x00,0x5F,0x00,0x00,0x00,0x00,0x00},
	{0x00,0x00,0x07,0x00,0x07,0x00,0x00,0x00},
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	{0x00,0x02,0x05,0x05,0x02,0x00,0x00,0x00}
};
//==========
// font11x16 =
//  11, // character width in pixels
//  2, // character height in pages (8 pixels)
//  32,64 // ASCII extents
#define OLED_CHAR_WIDTH_PIXEL_11X16  11 // character width in pixels
#define OLED_CHAR_HEIGHT_PAGE_11X16  2  // character height in pages (16 pixels)
#define BYTES_PER_FONT_11X16 		 22

const unsigned char Font11X16 [][BYTES_PER_FONT_11X16] = {
#if 0
     0x00, 0x00, 0x00, 0x00, 0x00, 0x00, 0x00, 0x00, 0x00, 0x00, 0x00, 0x00, 0x00, 0x00, 0x00, 0x00, 0x00, 0x00, 0x00, 0x00, 0x00, 0x00,  // char
     0x00, 0x00, 0x00, 0x00, 0xFE, 0xFE, 0xFE, 0x00, 0x00, 0x00, 0x00, 0x00, 0x00, 0x00, 0x00, 0x18, 0x19, 0x18, 0x00, 0x00, 0x00, 0x00,  // char !
     0x00, 0x00, 0x1C, 0xFC, 0x1C, 0x00, 0x00, 0x1C, 0xFC, 0x1C, 0x00, 0x00, 0x00, 0x00, 0x00, 0x00, 0x00, 0x00, 0x00, 0x00, 0x00, 0x00,  // char "
     0x30, 0x30, 0xFF, 0xFF, 0x30, 0x30, 0xFF, 0xFF, 0x30, 0x30, 0x00, 0x03, 0x03, 0x3F, 0x3F, 0x03, 0x03, 0x3F, 0x3F, 0x03, 0x03, 0x00,  // char #
     0x00, 0x38, 0x7C, 0x4C, 0xCF, 0xCF, 0xCC, 0x9C, 0x9C, 0x00, 0x00, 0x00, 0x0F, 0x0F, 0x0C, 0x7C, 0x7C, 0x0C, 0x0F, 0x07, 0x00, 0x00,  // char $
     0x00, 0x1C, 0xA2, 0xA2, 0xE2, 0xDC, 0x40, 0x60, 0x20, 0x00, 0x00, 0x00, 0x01, 0x01, 0x00, 0x0E, 0x11, 0x11, 0x11, 0x0E, 0x00, 0x00,  // char %
     0x00, 0x00, 0xB0, 0xF8, 0xCC, 0x8C, 0x0C, 0x0C, 0x8C, 0x80, 0x00, 0x00, 0x0F, 0x0F, 0x19, 0x18, 0x19, 0x1B, 0x0F, 0x1F, 0x19, 0x00,  // char &
     0x00, 0x00, 0x00, 0x00, 0x1C, 0xFC, 0x1C, 0x00, 0x00, 0x00, 0x00, 0x00, 0x00, 0x00, 0x00, 0x00, 0x00, 0x00, 0x00, 0x00, 0x00, 0x00,  // char '
     0x00, 0x00, 0x00, 0x00, 0x00, 0xE0, 0xF8, 0x1E, 0x06, 0x00, 0x00, 0x00, 0x00, 0x00, 0x00, 0x00, 0x07, 0x1F, 0x78, 0x60, 0x00, 0x00,  // char (
     0x00, 0x00, 0x06, 0x1E, 0xF8, 0xE0, 0x00, 0x00, 0x00, 0x00, 0x00, 0x00, 0x00, 0x60, 0x78, 0x1F, 0x07, 0x00, 0x00, 0x00, 0x00, 0x00,  // char )
     0x00, 0x00, 0x18, 0x98, 0xF0, 0xFE, 0xFE, 0xF0, 0x98, 0x18, 0x00, 0x00, 0x00, 0x00, 0x01, 0x01, 0x00, 0x00, 0x01, 0x01, 0x00, 0x00,  // char *
     0x80, 0x80, 0x80, 0x80, 0xF8, 0xF8, 0x80, 0x80, 0x80, 0x80, 0x00, 0x01, 0x01, 0x01, 0x01, 0x1F, 0x1F, 0x01, 0x01, 0x01, 0x01, 0x00,  // char +
     0x00, 0x00, 0x00, 0x00, 0x00, 0x00, 0x00, 0x00, 0x00, 0x00, 0x00, 0x00, 0x00, 0x00, 0x00, 0xE0, 0x3C, 0x04, 0x00, 0x00, 0x00, 0x00,  // char ,
     0x00, 0xC0, 0xC0, 0xC0, 0xC0, 0xC0, 0xC0, 0xC0, 0xC0, 0x00, 0x00, 0x00, 0x00, 0x00, 0x00, 0x00, 0x00, 0x00, 0x00, 0x00, 0x00, 0x00,  // char -
     0x00, 0x00, 0x00, 0x00, 0x00, 0x00, 0x00, 0x00, 0x00, 0x00, 0x00, 0x00, 0x00, 0x00, 0x00, 0x1C, 0x1C, 0x1C, 0x00, 0x00, 0x00, 0x00,  // char .
     0x00, 0x00, 0x00, 0x00, 0x80, 0xE0, 0xFC, 0x1F, 0x03, 0x00, 0x00, 0x00, 0x00, 0x60, 0x7C, 0x1F, 0x03, 0x00, 0x00, 0x00, 0x00, 0x00,  // char /
#endif
     {0x00, 0xF0, 0xFC, 0x0E, 0x06, 0x06, 0x0E, 0xFC, 0xF0, 0x00, 0x00, 0x00, 0x03, 0x0F, 0x1C, 0x18, 0x18, 0x1C, 0x0F, 0x03, 0x00, 0x00},  // char 0
     {0x00, 0x0C, 0x0C, 0x0C, 0xFE, 0xFE, 0x00, 0x00, 0x00, 0x00, 0x00, 0x00, 0x18, 0x18, 0x18, 0x1F, 0x1F, 0x18, 0x18, 0x18, 0x00, 0x00},  // char 1
     {0x00, 0x18, 0x1C, 0x0E, 0x06, 0x86, 0xCE, 0x7C, 0x38, 0x00, 0x00, 0x00, 0x18, 0x1C, 0x1E, 0x1B, 0x19, 0x18, 0x18, 0x18, 0x00, 0x00},  // char 2
     {0x00, 0x0C, 0x0C, 0xC6, 0xC6, 0xC6, 0xE6, 0xFC, 0x38, 0x00, 0x00, 0x0C, 0x1C, 0x18, 0x18, 0x18, 0x18, 0x19, 0x0F, 0x07, 0x00, 0x00},  // char 3
     {0x00, 0x80, 0xC0, 0x70, 0x38, 0x0E, 0xFE, 0xFE, 0x00, 0x00, 0x00, 0x00, 0x03, 0x03, 0x03, 0x1B, 0x1B, 0x1F, 0x1F, 0x1B, 0x00, 0x00},  // char 4
     {0x00, 0x00, 0xFE, 0xFE, 0x66, 0x66, 0xE6, 0xC6, 0x80, 0x00, 0x00, 0x00, 0x0C, 0x1C, 0x18, 0x18, 0x18, 0x1C, 0x0F, 0x07, 0x00, 0x00},  // char 5
     {0x00, 0xE0, 0xF8, 0xDC, 0x6C, 0x66, 0xE6, 0xC6, 0x86, 0x00, 0x00, 0x00, 0x03, 0x0F, 0x1C, 0x18, 0x18, 0x1C, 0x0F, 0x07, 0x00, 0x00},  // char 6
     {0x00, 0x0E, 0x0E, 0x06, 0x06, 0x86, 0xF6, 0xFE, 0x1E, 0x00, 0x00, 0x00, 0x00, 0x00, 0x00, 0x1C, 0x1F, 0x07, 0x00, 0x00, 0x00, 0x00},  // char 7
     {0x00, 0x38, 0xFC, 0xC6, 0xC6, 0xC6, 0xC6, 0xFC, 0x38, 0x00, 0x00, 0x00, 0x07, 0x0F, 0x18, 0x18, 0x18, 0x18, 0x0F, 0x07, 0x00, 0x00},  // char 8
     {0x00, 0x78, 0xFC, 0xCE, 0x86, 0x86, 0xCE, 0xFC, 0xF0, 0x00, 0x00, 0x00, 0x18, 0x18, 0x19, 0x19, 0x0D, 0x0E, 0x07, 0x01, 0x00, 0x00},  // char 9
     {0x00, 0x00, 0x00, 0x00, 0x70, 0x70, 0x70, 0x00, 0x00, 0x00, 0x00, 0x00, 0x00, 0x00, 0x00, 0x1C, 0x1C, 0x1C, 0x00, 0x00, 0x00, 0x00}  // char :
#if 0
     0x00, 0x00, 0x00, 0x00, 0x00, 0x00, 0x70, 0x70, 0x70, 0x00, 0x00, 0x00, 0x00, 0x00, 0x00, 0x60, 0x38, 0x0C, 0x04, 0x00, 0x00, 0x00,  // char ;
     0x80, 0xC0, 0xC0, 0x60, 0x30, 0x30, 0x18, 0x18, 0x0C, 0x0C, 0x00, 0x00, 0x01, 0x01, 0x03, 0x06, 0x06, 0x0C, 0x0C, 0x18, 0x18, 0x00,  // char <
     0x30, 0x30, 0x30, 0x30, 0x30, 0x30, 0x30, 0x30, 0x30, 0x30, 0x00, 0x03, 0x03, 0x03, 0x03, 0x03, 0x03, 0x03, 0x03, 0x03, 0x03, 0x00,  // char =
     0x0C, 0x0C, 0x18, 0x18, 0x30, 0x30, 0x60, 0xC0, 0xC0, 0x80, 0x80, 0x18, 0x18, 0x0C, 0x0C, 0x06, 0x06, 0x03, 0x01, 0x01, 0x00, 0x00,  // char >
     0x00, 0x00, 0x38, 0x3C, 0x8C, 0x8C, 0xCC, 0xFC, 0x78, 0x00, 0x00, 0x00, 0x00, 0x00, 0x18, 0x19, 0x19, 0x00, 0x00, 0x00, 0x00, 0x00,  // char ?
     0x00, 0x00, 0xF8, 0x04, 0xC2, 0x22, 0x22, 0xFC, 0x00, 0x00, 0x00, 0x00, 0x00, 0x0F, 0x10, 0x21, 0x22, 0x22, 0x13, 0x00, 0x00, 0x00,  // char @
#endif
};

// ----------------------------------------------------------------------------
//=========
// Standard ASCII 16x32 font
#define OLED_CHAR_WIDTH_PIXEL_16X32  	16 // character width in pixels
#define OLED_CHAR_HEIGHT_PAGE_16X32  	4  // character height in pages (32 pixels)
#define BYTES_PER_FONT_16X32 			64 //16X4

const unsigned char Font16x32_digits[][BYTES_PER_FONT_16X32] = {

		// @0x2e '.' (16 pixels wide)
		{0x00, //
		0x00, //
		0x00, //
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		0x00},  //

		//@0x30
		//'0' (16 pixels wide)
	{0x00,	//page 0
	0x00,
	0xC0,
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	0x00}, //

	// @192 '1' (16 pixels wide)
	{0x00, //
	0x00, //
	0x00, //                   ###
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	0x00}, //

	// @256 '2' (16 pixels wide)
	{0x00, // ###                 ###
	0xC0, // #####               ######
	0xE0, // #######             #######
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	0x00}, //

	// @320 '3' (16 pixels wide)
	{0x00, //      ###              ##
	0xC0, //    #####              ####
	0xE0, //   ######              #####
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	0x00}, //

	// @384 '4' (16 pixels wide)
	{0x00, //        ####
	0x00, //        ######
	0x00, //        ########
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	0x01}, //        ###

	// @448 '5' (16 pixels wide)
	{0x00, //      ###      ####
	0x80, //    #####      ###########
	0xF8, //   ######      ###############
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	0x00}, //

	// @512 '6' (16 pixels wide)
	{0x00, //         ############
	0x00, //     ####################
	0xC0, //    #######################
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	0x00}, //

	// @576 '7' (16 pixels wide)
	{0x38, //                           ###
	0x38, //                           ###
	0x38, //                           ###
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	0x00}, //

	// @640 '8' (16 pixels wide)
	{0x00, //      #######
	0x80, //    ###########     ######
	0xE0, //   #############  ##########
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	0x00}, //

	// @704 '9' (16 pixels wide)
	{0x00, //      ##         #######
	0xC0, //    ####      #############
	0xE0, //  ######     ###############
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	0x00}, //

	// @768 ':' (16 pixels wide)
	{0x00, //
	0x00, //
	0x00, //
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	0x00, //
	0x00}  //
};

//const DCfont TinyOLED4kfont16x32Digits = {
//  16, // character width in pixels
//  4,  // character height in pages (8 pixels)
//  0x2C,0x3A // ASCII extents
//  };

//=========
// Big numbers font, from 0 to 9 (96 bytes each)
#define OLED_CHAR_WIDTH_PIXEL_24X32  	24 // character width in pixels
#define OLED_CHAR_HEIGHT_PAGE_24X32  	4  // character height in pages (32 pixels)
#define BYTES_PER_FONT_24X32 			96 //3X4(X8)

const unsigned char bigNumbers [][BYTES_PER_FONT_24X32] = {
		//'0'
{0x00, 0x00, 0x00, 0xC0, 0xE0, 0xF0, 0xF0, 0xF0, 0xF0, 0xF0, 0xF0, 0xF0, 0xF0, 0xF0, 0xF0, 0xF0,
0xF0, 0xF0, 0xF0, 0xE0, 0xC0, 0x00, 0x00, 0x00, 0x00, 0x00, 0x00, 0xFF, 0xFF, 0xFF, 0xFF, 0x01,
0x00, 0x00, 0x00, 0x00, 0x00, 0x00, 0x00, 0x00, 0x01, 0xFF, 0xFF, 0xFF, 0xFF, 0x00, 0x00, 0x00,
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0x00, 0x00, 0x01, 0x01, 0x01, 0x01, 0x00, 0x00, 0x00, 0x00, 0x00, 0x00, 0x00, 0x00, 0x00, 0x00}
};

#endif

#if 0
//===
/* Font data from https://jared.geek.nz/2014/jan/custom-fonts-for-microcontrollers */
#define OLED_CHAR_WIDTH_PIXEL  6 // character width in pixels
#define OLED_CHAR_HEIGHT_PAGE 1 // character height in pages (8 pixels)

const unsigned char Font6X8[][6] = {
//const unsigned char ssd1306xled_font5x5 [][6] = {
  0x00,0x00,0x00,0x00,0x00,0x00, // 0x20 32
  0x5c,0x00,0x00,0x00,0x00,0x00, // 0x21 33 !
  0x06,0x00,0x06,0x00,0x00,0x00, // 0x22 34 "
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  0x00,0x00,0x00,0x00,0x00,0x00, // 0x7F 127
};

#endif

//== DRIVER ========================================================
unsigned char ozledsendbuf[80];//volatile unsigned char ozledsendbuf[80];

void SSD1306_OLED_SendCmd(unsigned char command);
void SSD1306_OLED_sendData(unsigned char data);
void SSD1306_OLED_setCursorXY(unsigned char X, unsigned char Y);
extern void delayms(uint32_t ms);

//Config
//for basic small 8x8
#define OLED_CHAR_WIDTH_PIXEL       OLED_CHAR_WIDTH_PIXEL_8X8
#define OLED_CHAR_HEIGHT_PAGE       OLED_CHAR_HEIGHT_PAGE_8X8
#define BYTES_PER_FONT          	BYTES_PER_FONT_8X8
//=====================================================================
void SSD1306_OLED_SendCmd(unsigned char command)
{
	ozledsendbuf[0]=SSD1306_OLED_COMMAND_MODE;//data mode
	ozledsendbuf[1]=command;
	stm_I2C_SendBurst(OLED_ADDRESS, &ozledsendbuf[0], 2);
}

void SSD1306_OLED_sendData(unsigned char data){
	ozledsendbuf[0]=SSD1306_OLED_DATA_MODE;//data mode
	ozledsendbuf[1]=data;
	stm_I2C_SendBurst(OLED_ADDRESS, &ozledsendbuf[0], 2);//I2CSendBurst(OLED_ADDRESS, ozledsendbuf, 2);
}

//set cursor per 8xPixels, perPage(8yPixels)
void SSD1306_OLED_setCursorXY(unsigned char X8, unsigned char YPage){
	// X - 1 unit = 8 pixel columns

    SSD1306_OLED_SendCmd(0x00 + (OLED_CHAR_WIDTH_PIXEL*X8 & 0x0F)); 		    //set lower column start address for page addressing mode
    SSD1306_OLED_SendCmd(0x10 + ((OLED_CHAR_WIDTH_PIXEL*X8 >> 4)&0x0F)); 		//set higher column start address for page addressing mode

    // Y - 1 unit = 1 page (8 pixel rows)
    //Set Page Start Address for Page Addressing Mode (0x10110-P2P1P0)
	SSD1306_OLED_SendCmd(0xB0 + YPage); 									//set page start address for page addressing mode
}

void SSD1306_OLED_clearDisplay(void)	{
	unsigned char page;
	unsigned char column;

	for(page=0; page<8; page++) {
		SSD1306_OLED_setCursorXY(0, page);
		for(column=0; column<128; column++){  //clear all columns
			SSD1306_OLED_sendData(0);
		}
	}
	SSD1306_OLED_setCursorXY(0,0);
}

/*
void SSD1306_OLED_clearPage(byte page)	{
	// clear page and set cursor at beginning of that page

	setCursorXY(0, page);
	for(byte column=0; column<128; column++){  //clear all columns
		SSD1306_OLED_sendData(0x00);
	}

}
*/

void SSD1306_OLED_setNormalDisplay(void){
	SSD1306_OLED_SendCmd(SSD1306_OLED_CMD_NORMAL_DISPLAY); //0xA6
}

void SSD1306_OLED_setInverseDisplay(void){
	SSD1306_OLED_SendCmd(SSD1306_OLED_CMD_INVERSE_DISPLAY); //0xA7
}


void SSD1306_OLED_setPowerOff(void){
	SSD1306_OLED_SendCmd(SSD1306_OLED_CMD_DISPLAY_OFF); //0xAE
}

void SSD1306_OLED_setPowerOn(void){
	SSD1306_OLED_SendCmd(SSD1306_OLED_CMD_DISPLAY_ON);
}

void SSD1306_OLED_setBrightness(unsigned char Brightness){
	SSD1306_OLED_SendCmd(SSD1306_OLED_CMD_SET_BRIGHTNESS); //0x81
	SSD1306_OLED_SendCmd(Brightness);
}


//0x22 : Set page Addressing mode (default addressing Mode)
void SSD1306_OLED_setPageMode(void){
	g_OzOled.addressingMode = PAGE_ADDRESSING;
	SSD1306_OLED_SendCmd(SSD1306_OLED_MEMORY_MODE);//0x20); 				//set addressing mode
	SSD1306_OLED_SendCmd(PAGE_ADDRESSING); 	//set page addressing mode
}

//0x20 : Set Memory Addressing Mode with Horizontal Addressing Mode
void SSD1306_OLED_setHorizontalMode(){
	g_OzOled.addressingMode = HORIZONTAL_ADDRESSING;
	SSD1306_OLED_SendCmd(SSD1306_OLED_MEMORY_MODE);//0x20); 				//set addressing mode
	SSD1306_OLED_SendCmd(HORIZONTAL_ADDRESSING); 	//set page addressing mode
}

// startscrollright
// Activate a right handed scroll for rows start through stop
// Hint, the display is 16 rows tall. To scroll the whole display, run:
// scrollRight(0x00, 0x0F)  - start - stop
void SSD1306_OLED_scrollRight(unsigned char start, unsigned char end, unsigned char speed){

    SSD1306_OLED_SendCmd(SSD1306_OLED_RIGHT_SCROLL);  //Horizontal Scroll Setup
    SSD1306_OLED_SendCmd(0x00);	// dummy byte
    SSD1306_OLED_SendCmd(start);	// start page address
    SSD1306_OLED_SendCmd(speed);	// set time interval between each scroll
    SSD1306_OLED_SendCmd(end);	// end page address

    SSD1306_OLED_SendCmd(0x01);
    SSD1306_OLED_SendCmd(0xFF);

    SSD1306_OLED_SendCmd(0x2f);  //active scrolling
}

// startscrollleft
// Activate a right handed scroll for rows start through stop
// Hint, the display is 16 rows tall. To scroll the whole display, run:
// display.scrollright(0x00, 0x0F)   - start - stop
void SSD1306_OLED_scrollLeft(unsigned char start, unsigned char end, unsigned char speed){

    SSD1306_OLED_SendCmd(SSD1306_OLED_LEFT_SCROLL);  //Horizontal Scroll Setup
    SSD1306_OLED_SendCmd(0x00);	// dummy byte
    SSD1306_OLED_SendCmd(start);	// start page address
    SSD1306_OLED_SendCmd(speed);	// set time interval between each scroll
    SSD1306_OLED_SendCmd(end);	// end page address

    SSD1306_OLED_SendCmd(0x01);
    SSD1306_OLED_SendCmd(0xFF);

    SSD1306_OLED_SendCmd(0x2f);  //active scrolling
}

// startscrolldiagright
// Activate a diagonal scroll for rows start through stop
// Hint, the display is 16 rows tall. To scroll the whole display, run:
// display.scrollright(0x00, 0x0F)
void SSD1306_OLED_scrollDiagRight(){

        SSD1306_OLED_SendCmd(SSD1306_OLED_SET_VERTICAL_SCROLL_AREA);
        SSD1306_OLED_SendCmd(0X00);
        SSD1306_OLED_SendCmd(OLED_SCREEN_HEIGHT_IN_PIXEL);
        SSD1306_OLED_SendCmd(SSD1306_OLED_VERTICAL_RIGHT_SCROLL); //Vertical and Horizontal Scroll Setup
        SSD1306_OLED_SendCmd(0X00); 	//dummy byte
        SSD1306_OLED_SendCmd(0x00);	 //define page0 as startpage address
        SSD1306_OLED_SendCmd(0X00);	//set time interval between each scroll ste as 6 frames
        SSD1306_OLED_SendCmd(0x07);	//define page7 as endpage address
        SSD1306_OLED_SendCmd(0X01);	//set vertical scrolling offset as 1 row
        SSD1306_OLED_SendCmd(SSD1306_OLED_CMD_ACTIVATE_SCROLL); //active scrolling
}

void SSD1306_OLED_scrollDiagLeft(){

        SSD1306_OLED_SendCmd(SSD1306_OLED_SET_VERTICAL_SCROLL_AREA);
        SSD1306_OLED_SendCmd(0X00);
        SSD1306_OLED_SendCmd(OLED_SCREEN_HEIGHT_IN_PIXEL);
        SSD1306_OLED_SendCmd(SSD1306_OLED_VERTICAL_LEFT_SCROLL); //Vertical and Horizontal Scroll Setup
        SSD1306_OLED_SendCmd(0X00); //dummy byte
        SSD1306_OLED_SendCmd(0x00);	 //define page0 as startpage address
        SSD1306_OLED_SendCmd(0X00);	//set time interval between each scroll ste as 6 frames
        SSD1306_OLED_SendCmd(0x07);	//define page7 as endpage address
        SSD1306_OLED_SendCmd(0X01);	//set vertical scrolling offset as 1 row
        SSD1306_OLED_SendCmd(SSD1306_OLED_CMD_ACTIVATE_SCROLL); //active scrolling
}

void SSD1306_OLED_setActivateScroll(unsigned char direction, unsigned char startPage, unsigned char endPage, unsigned char scrollSpeed){

	if(direction == Scroll_Right) {
		SSD1306_OLED_SendCmd(0x26);
	}
	else {
		//Scroll Left
		SSD1306_OLED_SendCmd(0x27);

	}
	/*
	else if (direction == Scroll_Up ){

		//Scroll Up
		SSD1306_OLED_SendCmd(0x29);

	}
	else{

		//Scroll Down
		SSD1306_OLED_SendCmd(0x2A);

	}
	*/
	SSD1306_OLED_SendCmd(0x00);//dummy byte
	SSD1306_OLED_SendCmd(startPage);
	SSD1306_OLED_SendCmd(scrollSpeed);
	SSD1306_OLED_SendCmd(endPage);		// for verticle scrolling, use 0x29 as command, endPage should = start page = 0

	/*
	if(direction == Scroll_Up) {

		SSD1306_OLED_SendCmd(0x01);

	}
	*/

	SSD1306_OLED_SendCmd(SSD1306_OLED_CMD_ACTIVATE_SCROLL);
}

void SSD1306_OLED_setDeactivateScroll(){
	SSD1306_OLED_SendCmd(SSD1306_OLED_CMD_DEACTIVATE_SCROLL);
}
//===================================================================================
void SSD1306_OLED_drawBitmap(const unsigned char *bitmaparray,
		unsigned char X8, unsigned char Y8,
		unsigned char width, unsigned char height)
{
	unsigned char i;
	unsigned char column = 0;

	SSD1306_OLED_setCursorXY(X8, Y8);

	for(i=0; i < width*8*height; i++) {

		SSD1306_OLED_sendData(bitmaparray[i]);

		if(++column == width*8) {
			column = 0;
			SSD1306_OLED_setCursorXY( X8, ++Y8 );
		}
	}
}

void SSD1306_OLED_printChar_8X8(char C, unsigned char X8, unsigned char Y8){
	unsigned char i;
	//if ( X8 < 128 )
		SSD1306_OLED_setCursorXY(X8, Y8);

	//Ignore unused ASCII characters. Modified the range to support multilingual characters.
    if(C < 32 || C > 127)	C='*'; //star - indicate characters that can't be displayed

    for(i=0; i < OLED_CHAR_WIDTH_PIXEL; i++) {
    	SSD1306_OLED_sendData(Font8X8[C-32][i]);
    }
}

void SSD1306_OLED_printChar_8X8_Inverse(char C, unsigned char X8, unsigned char Y8){
	unsigned char i;
	//if ( X8 < 128 )
		SSD1306_OLED_setCursorXY(X8, Y8);

	//Ignore unused ASCII characters. Modified the range to support multilingual characters.
    if(C < 32 || C > 127)	C='*'; //star - indicate characters that can't be displayed

    for(i=0; i < OLED_CHAR_WIDTH_PIXEL; i++) {
    	SSD1306_OLED_sendData(~(Font8X8[C-32][i]));
    }
}

void SSD1306_OLED_printString_8X8(const char *str, unsigned char X8, unsigned char Ypg, unsigned char numChar){
	unsigned char count=0;

	//if ( X8 < 16 ) //max width / 8 <-- (128/8)
	//	SSD1306_OLED_setCursorXY(X8, Ypg);

   	while(str[count] && (count < numChar)){
   		SSD1306_OLED_printChar_8X8(str[count],X8+count,Ypg);
   		count++;
	}
}

unsigned char SSD1306_OLED_printNumber_8X8(long long_num, unsigned char X8, unsigned char Y8){

	if ( X8 < 16 )  SSD1306_OLED_setCursorXY(X8, Y8);

	unsigned char char_buffer[10] = "";
	unsigned char i = 0;
	unsigned char f = 0; // number of characters
	unsigned char xpos=0;

	if (long_num < 0) {

		f++;
		SSD1306_OLED_printChar_8X8('-',X8,Y8);
		long_num = -long_num;
	}
	else if (long_num == 0) {

		f++;
		SSD1306_OLED_printChar_8X8('0',X8,Y8);
		return f;
	}

	while (long_num > 0) {

		char_buffer[i++] = long_num % 10;
		long_num /= 10;
	}

	f += i;
	xpos=0;
	for(; i > 0; i--) {
		xpos++;
		SSD1306_OLED_printChar_8X8('0'+ char_buffer[i - 1],X8+xpos,Y8);
	}
	return f;
}

void SSD1306_OLED_printNumber_16X32(const char *str, unsigned char X8, unsigned char Y8, unsigned char numChar){
// ocr number pixels: 16 x 24
	unsigned char i;
 // Y - page
	unsigned char column = 0;
	unsigned char count = 0;

	while(str[count] && count<numChar){
		SSD1306_OLED_setCursorXY(X8, Y8);
		for(i=0; i < BYTES_PER_FONT_16X32; i++) {
			if(str[count] < '.' || str[count] > ':')
				SSD1306_OLED_sendData(0);
			// if character is not "0-9" or ':'
			//if(str[count] < 48 || str[count] > 58)
			//	SSD1306_OLED_sendData(0);
			else{
				if(str[count] == '.')
					SSD1306_OLED_sendData(Font16x32_digits[0][i]);
				else
					SSD1306_OLED_sendData(Font16x32_digits[str[count]-'0' + 1][i]);
			}

			if(column >= (OLED_CHAR_WIDTH_PIXEL_16X32 - 1)){  //15){
				column = 0;
				SSD1306_OLED_setCursorXY(X8, ++Y8);
			}
			else
				column++;
		}
		count++;

		X8 = X8 + OLED_CHAR_WIDTH_PIXEL_16X32/8;//2; //16 pixel X
		Y8 = Y8 - OLED_CHAR_HEIGHT_PAGE_16X32;  // 4; //32 pixel Y
	}
}
//24X32 (3X4)
void SSD1306_OLED_printBigNumber(const char *number, unsigned char X8, unsigned char Ypg, unsigned char numChar){
// big number pixels: 24 x 32
	unsigned char i;
 // Y - page
	unsigned char column = 0;
	unsigned char count = 0;

	while(number[count] && count<numChar){
		SSD1306_OLED_setCursorXY(X8, Ypg);
		for(i=0; i < BYTES_PER_FONT_24X32; i++) {
			// if character is not "0-9" or ':'
			if(number[count] < 48 || number[count] > 58)
				SSD1306_OLED_sendData(0);
			else
				SSD1306_OLED_sendData(bigNumbers[number[count]-48][i]);

			if(column >= 23){
				column = 0;
				SSD1306_OLED_setCursorXY(X8, ++Ypg);
			}
			else
				column++;

		}
		count++;

		X8 = X8 + OLED_CHAR_WIDTH_PIXEL_24X32/8 ;//3 x 8 pixel
		Ypg = Ypg - OLED_CHAR_HEIGHT_PAGE_24X32;	 //4 page;
	}
}

//========== X is by pixel unit. Y is by page unit == Support for Font 11x16...
//set cursor x per Pixels, y perPage(8yPixels)
void SSD1306_OLED_setCursorXYbyPixel(unsigned char X, unsigned char Ypg){

    SSD1306_OLED_SendCmd(0x00 + (X & 0x0F)); 		    //set lower column start address for page addressing mode
    SSD1306_OLED_SendCmd(0x10 + ((X >> 4)&0x0F)); 		//set higher column start address for page addressing mode

    //Set Page Start Address for Page Addressing Mode (0x10110-P2P1P0)
	SSD1306_OLED_SendCmd(0xB0 + Ypg); 									//set page start address for page addressing mode

}
/*
void SSD1306_OLED_printCharByPixel(char C, unsigned char X, unsigned char Y8){
	unsigned char i;

	if ( X < 128 ) //sanity check
		SSD1306_OLED_setCursorXYbyPixel(X, Y8);

	//Ignore unused ASCII characters. Modified the range to support multilingual characters.
    if(C < 32 || C > 127)	C='*'; //star - indicate characters that can't be displayed

    for(i=0; i < OLED_CHAR_WIDTH_PIXEL; i++) {
    	SSD1306_OLED_sendData(Font8X8[C-32][i]);
    }
}

void SSD1306_OLED_printStringByPixel(const char *String, unsigned char X, unsigned char Y8, unsigned char numChar, unsigned char xPixelsPerChar){
	unsigned char count=0;

	if ( X < 128 ) //sanity check
		SSD1306_OLED_setCursorXYbyPixel(X, Y8);

   	while(String[count] && (count<numChar)){
   		SSD1306_OLED_printCharByPixel(String[count++], X+count+xPixelsPerChar, Y8);
	}
}
*/
//X by pixel unit
//Y by page unit
void SSD1306_OLED_printNumber_11X16(const char *number, unsigned char X, unsigned char Ypg, unsigned char numChar){
	unsigned char i;
	unsigned char column = 0;
	unsigned char count = 0;

	while(number[count] && count<numChar)
	{
		SSD1306_OLED_setCursorXYbyPixel(X, Ypg);

		//draw a digit
		for(i=0; i < BYTES_PER_FONT_11X16; i++) {
			if(number[count] < 48 || number[count] > 58) // if character is not "0-9" or ':'
				SSD1306_OLED_sendData(0);
			else
				SSD1306_OLED_sendData(Font11X16[number[count]-48][i]);

			if(column >= (OLED_CHAR_WIDTH_PIXEL_11X16 - 1)){  //10){ //check after draw 11 pixels.
				column = 0;
				SSD1306_OLED_setCursorXYbyPixel(X, ++Ypg); //goto next y page.
			}
			else
				column++;
		}

		//next digit
		count++;

		X = X + OLED_CHAR_WIDTH_PIXEL_11X16;//11; //11 pixel X -- advance 11 pixels on X axis.
		Ypg = Ypg - OLED_CHAR_HEIGHT_PAGE_11X16; //2;    //return to original starting Y point (2 pages Y)
	}
}
//==========

//unsigned char flipCmds = [0x21, 0, 127, 0x22, 0, 0x07]; //64
//unsigned char flipCmds = [0x21, 0, 127, 0x22, 0, 0x03]; //32

// =================== High Level ===========================
void SSD1306_OLED_init(char *str){

	int i = 0;
	if(g_OzLED_InitDone){
		printf("SSD1306_OLED_init() Already Done.\r\n");
		return;
	}

	if(!g_bI2CModuleConfigDone){
#if (USE_DISPLAY == USE_DISPLAY_OLED)
#if (PROCESSOR == PROCESSOR_STM32F407VZT6)
	gI2Cx = I2C2;
#else
	gI2Cx = I2C1;
#endif
#endif
		printf("I2C Init...");
		stm_I2C_Init(gI2Cx,I2C_SPEED);//100 or 400Kbps - for OLED
		g_bI2CModuleConfigDone = 1;
		printf("Done.\r\n");
	}else{
		printf("stmOzOLED> I2C Init Already Done.");
	}

    SSD1306_OLED_setPowerOff(); 		//display off (0xAE)
    delayms(10);

    SSD1306_OLED_SendCmd(0xD5); SSD1306_OLED_SendCmd(0x80);//set display clock divide ratio

    SSD1306_OLED_SendCmd(SSD1306_OLED_CMD_SETMULTIPLEX); //0xA8
    SSD1306_OLED_SendCmd(OLED_SCREEN_HEIGHT_IN_PIXEL-1); //mux ratio -- 0x1f for 32, 0x3f for 64

    SSD1306_OLED_SendCmd(0xD3); //Set Display Offset
    SSD1306_OLED_SendCmd(0x00);

    SSD1306_OLED_SendCmd(0x40); //Set Display Start Line

	SSD1306_OLED_SendCmd(SSD1306_OLED_CMD_CHARGEPUMP);//0x8d); 		//SSD1306: ChargePump Setting
	SSD1306_OLED_SendCmd(0x14); //Enable ChargPump internal DC/DC

	SSD1306_OLED_SendCmd(0xA1); //Set segment re-map
	SSD1306_OLED_SendCmd(0xC8); //Set Com output Scan Direction

	SSD1306_OLED_SendCmd(0xDA);//Set COM HW Config
#if (OLED_SCREEN_HEIGHT_IN_PIXEL == 64)
	SSD1306_OLED_SendCmd(0x12);// for 64; //COM HW Config
#else
	SSD1306_OLED_SendCmd(0x02);// for 32; //COM HW Config
#endif

	SSD1306_OLED_SendCmd(0x81);//Set Contrast
	SSD1306_OLED_SendCmd(0xCF);//OLED_CONTRAST); //Contrast Value 0x8F

	SSD1306_OLED_SendCmd(0xD9); SSD1306_OLED_SendCmd(0xF1);//Set Precharge Period

	SSD1306_OLED_SendCmd(0xDB); SSD1306_OLED_SendCmd(0x40);//Set VCOMH Deselect Level

	SSD1306_OLED_SendCmd(0xA4); //Set all pixels OFF

	SSD1306_OLED_setNormalDisplay();  	//default Set Normal Display == 0xA6 ('1'= ON pixel)

	SSD1306_OLED_SendCmd(SSD1306_OLED_CMD_DISPLAY_ON); //0xAF

	SSD1306_OLED_clearDisplay();

    delayms(100);

	SSD1306_OLED_setPageMode();
	SSD1306_OLED_setCursorXY(0,0);
	SSD1306_OLED_printString_8X8(str,0,0,15); //Print the String

	g_OzLED_InitDone = 1;
}

void SSD1306_OLED_showClock(unsigned h, unsigned m, unsigned s, unsigned xpos, unsigned ypos)
{
	char str[20];
	sprintf(str,"%02u:%02u:%02u",h, m, s);
	//SSD1306_OLED_printString_8X8(str,xpos,ypos,14);
	SSD1306_OLED_printNumber_11X16(str,0,2,8);
}
void SSD1306_OLED_showDate(unsigned y, unsigned mo, unsigned d, unsigned xpos, unsigned ypos)
{
	char str[20];
	sprintf(str,"20%02u/%02u/%02u",y, mo, d);
	SSD1306_OLED_printString_8X8(str,0,1,10);

}
void SSD1306_OLED_Loop(){
	int i;
	char str[10];

	printf("OzOled Loop\r\n");
	SSD1306_OLED_init("HELLO");
	delayms(100);

	SSD1306_OLED_drawBitmap(bitmaparray[2],15,0,1,1);
	SSD1306_OLED_drawBitmap(bitmaparray[0],15,3,1,1);

	i=0;
	while(1){
	  sprintf(str,"12:01:%02d",i);

	  //SSD1306_OLED_showClock(12,13,i, 0, 0);
	  //SSD1306_OLED_printBigNumber(str,0,0,5);
	  //SSD1306_OLED_printNumber_16X32(str,0,0,8);
	  //SSD1306_OLED_printChar_8X8('A',0,0);
	  SSD1306_OLED_printString_8X8(">2021/04/05",0,0,12);
	  SSD1306_OLED_printNumber_11X16(str,0,2,8);
	  //printf("%d",i);
	  i++;
	  if(i==60)
		  i=0;
	  delayms(1000);
  };
}
